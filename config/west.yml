## config/west.yml
```yaml
manifest:
  remotes:
    - name: zmkfirmware
      url-base: https://github.com/zmkfirmware
    - name: urob
      url-base: https://github.com/urob
  projects:
    - name: zmk
      remote: zmkfirmware
      revision: main #v0.1 # set to desired version
      import: app/west.yml
    - name: zmk-auto-layer
      remote: urob
      revision: main #v0.1 # set to same version as zmk
  self:
    path: config
```
